## boards/shields/sweep_ish/Kconfig.shield
```kconfig
config SHIELD_SWEEP_ISH_LEFT
    def_bool $(shields_list_contains,sweep_ish_left)

config SHIELD_SWEEP_ISH_RIGHT
    def_bool $(shields_list_contains,sweep_ish_right)
```

## boards/shields/sweep_ish_left/Kconfig.defconfig
```kconfig
if SHIELD_SWEEP_ISH_LEFT

config ZMK_KEYBOARD_NAME
    default 'Sweep-ish'

endif
```

## boards/shields/sweep_ish_left/Kconfig.shield
```kconfig
config SHIELD_SWEEP_ISH_LEFT
    def_bool $(shields_list_contains,sweep_ish_left)
```

## boards/shields/sweep_ish_right/Kconfig.defconfig
```kconfig
if SHIELD_SWEEP_ISH_RIGHT

config ZMK_KEYBOARD_NAME
    default 'Sweep-ish'

endif
```

## boards/shields/sweep_ish_right/Kconfig.shield
```kconfig
config SHIELD_SWEEP_ISH_RIGHT
    def bool $(shields_list_contains, sweep_ish_right)
```

## config/Kconfig.defconfig
```kconfig
if SHIELD_SWEEP_ISH_LEFT

config ZMK_KEYBOARD_NAME
    default 'Sweep-ish'

else if SHIELD_SWEEP_ISH_RIGHT

config ZMK_KEYBOARD_NAME
    default 'Sweep-ish'

endif
```
